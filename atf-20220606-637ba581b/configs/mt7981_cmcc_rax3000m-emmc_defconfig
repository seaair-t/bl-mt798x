## atf-20220606-637ba581b/configs/mt7981_cmcc_rax3000m-emmc_defconfig
```kconfig
CONFIG_PLAT_MT7981=y
CONFIG_TARGET_BL2=y
CONFIG_FLASH_DEVICE_EMMC=y
CONFIG_BGA=y
CONFIG_LOG_LEVEL_NONE=y
CONFIG_DRAM_DDR4=y
```
